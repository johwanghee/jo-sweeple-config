## boards/shields/sweeple/Kconfig.shield
```kconfig
# Copyright (c) 2020 The ZMK Contributors
# SPDX-License-Identifier: MIT

config SHIELD_SWEEPLE_CENTRAL_DONGLE
	def_bool $(shields_list_contains,SWEEPLE_central_dongle)

config SHIELD_SWEEPLE_CENTRAL_LEFT
    def_bool $(shields_list_contains,SWEEPLE_central_left)

config SHIELD_SWEEPLE_PERIPHERAL_LEFT
    def_bool $(shields_list_contains,SWEEPLE_peripheral_left)

config SHIELD_SWEEPLE_PERIPHERAL_RIGHT
    def_bool $(shields_list_contains,SWEEPLE_peripheral_right)
```
